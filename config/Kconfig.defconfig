## config/Kconfig.defconfig
```kconfig
if SHIELD_CRADIO_LEFT

config ZMK_KEYBOARD_NAME
	default "Cradio"

config ZMK_SPLIT_BLE_ROLE_CENTRAL
	default y

config ZMK_DISPLAY
	select LVGL_FONT_MONTSERRAT_24
     
endif	



if SHIELD_CRADIO_RIGHT

config ZMK_KEYBOARD_NAME
	default "c_Right"

endif


if SHIELD_CRADIO_RIGHT || SHIELD_CRADIO_LEFT

config ZMK_SPLIT
	default y
	

	
	
endif
```

## config/Kconfig.shield
```kconfig
# Copyright (c) 2020 Pete Johanson
# SPDX-License-Identifier: MIT

config SHIELD_CRADIO_LEFT
	def_bool $(shields_list_contains,cradio_left)

config SHIELD_CRADIO_RIGHT
	def_bool $(shields_list_contains,cradio_right)
```
